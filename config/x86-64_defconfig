## config/x86-64_defconfig
```kconfig
CONFIG_TARGET_x86=y
CONFIG_TARGET_x86_64=y
CONFIG_TARGET_x86_64_DEVICE_generic=y
CONFIG_TARGET_ROOTFS_PARTSIZE=2048
# CONFIG_TARGET_ROOTFS_TARGZ is not set
# CONFIG_TARGET_ROOTFS_SQUASHFS is not set

CONFIG_GRUB_TIMEOUT="1"
CONFIG_LUCI_SRCDIET=y
CONFIG_PACKAGE_dosfstools=y
CONFIG_PACKAGE_kmod-fs-msdos=y
CONFIG_PACKAGE_kmod-nls-cp932=y
CONFIG_PACKAGE_kmod-nls-cp936=y
CONFIG_PACKAGE_kmod-nls-cp950=y
CONFIG_PACKAGE_exfat-mkfs=y
CONFIG_PACKAGE_exfat-fsck=y
CONFIG_PACKAGE_kmod-fs-ntfs=y
CONFIG_PACKAGE_ntfs-3g-utils=y
CONFIG_PACKAGE_ntfs-3g=y
CONFIG_PACKAGE_kmod-fuse=y
CONFIG_PACKAGE_libgcrypt=y
CONFIG_PACKAGE_libgpg-error=y
CONFIG_PACKAGE_mdadm=y
CONFIG_PACKAGE_kmod-md-mod=y
CONFIG_PACKAGE_kmod-md-raid0=y
CONFIG_PACKAGE_kmod-md-raid10=y
CONFIG_PACKAGE_kmod-md-raid1=y
CONFIG_PACKAGE_kmod-md-raid456=y
CONFIG_PACKAGE_kmod-md-linear=y
CONFIG_PACKAGE_ath10k-firmware-qca9888=y
CONFIG_PACKAGE_ath10k-firmware-qca988x=y
CONFIG_PACKAGE_ath10k-firmware-qca9984=y
CONFIG_PACKAGE_autocore=y
CONFIG_PACKAGE_automount=y
CONFIG_PACKAGE_brcmfmac-firmware-43602a1-pcie=y
CONFIG_PACKAGE_default-settings=y
# CONFIG_PACKAGE_dnsmasq is not set
CONFIG_PACKAGE_dnsmasq-full=y
CONFIG_PACKAGE_fdisk=y
CONFIG_PACKAGE_luci-app-adguardhome=y
CONFIG_PACKAGE_luci-app-dockerman=y
CONFIG_PACKAGE_dockerd=y
CONFIG_PACKAGE_v2raya=y
CONFIG_PACKAGE_parted=y
CONFIG_PACKAGE_php8=y
CONFIG_PACKAGE_php8-cgi=y
CONFIG_PACKAGE_php8-mod-ctype=y
CONFIG_PACKAGE_php8-mod-fileinfo=y
CONFIG_PACKAGE_php8-mod-iconv=y
CONFIG_PACKAGE_luci-app-smartdns=y
# CONFIG_PACKAGE_luci-app-pingcontrol is not set
CONFIG_PACKAGE_php8-mod-mbstring=y
CONFIG_PACKAGE_php8-mod-session=y
CONFIG_PACKAGE_php8-mod-zip=y
CONFIG_PACKAGE_kmod-8139cp=y
CONFIG_PACKAGE_kmod-8139too=y
CONFIG_PACKAGE_kmod-ath10k=y
CONFIG_PACKAGE_kmod-igbvf=y
CONFIG_PACKAGE_kmod-mmc-spi=y
CONFIG_PACKAGE_kmod-mt7663u=y
CONFIG_PACKAGE_kmod-mt76x0u=y
CONFIG_PACKAGE_kmod-mt76x2u=y
CONFIG_PACKAGE_kmod-pcnet32=y
CONFIG_PACKAGE_kmod-r8125=y
CONFIG_PACKAGE_kmod-rtl8192cu=y
CONFIG_PACKAGE_kmod-rtl8812au-ct=y
CONFIG_PACKAGE_kmod-tulip=y
CONFIG_PACKAGE_kmod-usb-hid=y
CONFIG_PACKAGE_kmod-usb-net-rndis=y
CONFIG_PACKAGE_kmod-usb-net-rtl8152-vendor=y
CONFIG_PACKAGE_kmod-vmxnet3=y
CONFIG_PACKAGE_libubox202312041=y
CONFIG_PACKAGE_libblobmsg-json202312041=y

CONFIG_PACKAGE_kmod-iwlwifi=y
CONFIG_PACKAGE_modeminfo=y
CONFIG_PACKAGE_modeminfo-serial-xmm=y
CONFIG_PACKAGE_lm-sensors-detect=y
CONFIG_PACKAGE_luci-app-modeminfo=y
CONFIG_PACKAGE_luci-app-atinout=y
CONFIG_PACKAGE_luci-app-diskman=y
CONFIG_PACKAGE_luci-proto-xmm=y
CONFIG_PACKAGE_luci-app-passwall=y
CONFIG_PACKAGE_luci-app-openclash=y
CONFIG_PACKAGE_luci-app-ramfree=y
CONFIG_PACKAGE_luci-app-zerotier=y
CONFIG_PACKAGE_luci-ssl=y
CONFIG_PACKAGE_badvpn=y
CONFIG_PACKAGE_irqbalance=y
CONFIG_PACKAGE_iw=y
CONFIG_PACKAGE_iwinfo=y
CONFIG_PACKAGE_corkscrew=y
CONFIG_PACKAGE_iwlwifi-firmware-ax200=y
CONFIG_PACKAGE_wwan=y
CONFIG_PACKAGE_kmod-wwan=y
CONFIG_PACKAGE_lm-sensors=y
CONFIG_PACKAGE_lsblk=y
CONFIG_PACKAGE_ksmbd-utils=y
CONFIG_PACKAGE_luci-theme-bootstrap=y
# CONFIG_PACKAGE_open-vm-tools is not set
CONFIG_PACKAGE_wpad-basic-mbedtls=y

CONFIG_PACKAGE_base-files=y
CONFIG_PACKAGE_busybox=y
CONFIG_PACKAGE_ca-bundle=y
CONFIG_PACKAGE_dropbear=y
CONFIG_PACKAGE_e2fsprogs=y
CONFIG_PACKAGE_firewall4=y
CONFIG_PACKAGE_fstools=y
CONFIG_PACKAGE_grub2-bios-setup=y
CONFIG_PACKAGE_kmod-amazon-ena=y
CONFIG_PACKAGE_kmod-amd-xgbe=y
CONFIG_PACKAGE_kmod-bnx2=y
CONFIG_PACKAGE_kmod-button-hotplug=y
CONFIG_PACKAGE_kmod-e1000=y
CONFIG_PACKAGE_kmod-e1000e=y
CONFIG_PACKAGE_kmod-forcedeth=y
CONFIG_PACKAGE_kmod-fs-vfat=y
CONFIG_PACKAGE_kmod-igb=y
CONFIG_PACKAGE_kmod-igc=y
CONFIG_PACKAGE_kmod-ixgbe=y
CONFIG_PACKAGE_kmod-nft-offload=y
CONFIG_PACKAGE_kmod-r8169=y
CONFIG_PACKAGE_kmod-tg3=y
CONFIG_PACKAGE_libc=y
CONFIG_PACKAGE_libgcc=y
CONFIG_PACKAGE_libustream-mbedtls=y
CONFIG_PACKAGE_logd=y
CONFIG_PACKAGE_luci=y
CONFIG_PACKAGE_mkf2fs=y
CONFIG_PACKAGE_mtd=y
CONFIG_PACKAGE_netifd=y
CONFIG_PACKAGE_nftables=y
CONFIG_PACKAGE_odhcp6c=y
CONFIG_PACKAGE_odhcpd-ipv6only=y
CONFIG_PACKAGE_opkg=y
CONFIG_PACKAGE_partx-utils=y
CONFIG_PACKAGE_ppp=y
CONFIG_PACKAGE_ppp-mod-pppoe=y
CONFIG_PACKAGE_procd=y
CONFIG_PACKAGE_procd-seccomp=y
CONFIG_PACKAGE_procd-ujail=y
CONFIG_PACKAGE_uci=y
CONFIG_PACKAGE_uclient-fetch=y
CONFIG_PACKAGE_urandom-seed=y
CONFIG_PACKAGE_urngd=y
CONFIG_PACKAGE_alsa-utils=y
CONFIG_PACKAGE_block-mount=y
CONFIG_PACKAGE_dnsmasq-full=y
CONFIG_PACKAGE_fdisk=y
CONFIG_PACKAGE_kmod-8139cp=y
CONFIG_PACKAGE_kmod-8139too=y
CONFIG_PACKAGE_kmod-ac97=y
CONFIG_PACKAGE_kmod-fs-f2fs=y
CONFIG_PACKAGE_kmod-i40e=y
CONFIG_PACKAGE_kmod-igbvf=y
CONFIG_PACKAGE_kmod-ixgbevf=y
CONFIG_PACKAGE_kmod-nf-nathelper=y
CONFIG_PACKAGE_kmod-nf-nathelper-extra=y
CONFIG_PACKAGE_kmod-pcnet32=y
CONFIG_PACKAGE_kmod-tulip=y
CONFIG_PACKAGE_kmod-usb-audio=y
CONFIG_PACKAGE_kmod-usb-hid=y
CONFIG_PACKAGE_kmod-usb-net=y
# CONFIG_PACKAGE_kmod-usb-net-asix is not set
# CONFIG_PACKAGE_kmod-usb-net-asix-ax88179 is not set
CONFIG_PACKAGE_kmod-usb-net-rtl8150=y
CONFIG_PACKAGE_kmod-vmxnet3=y
CONFIG_PACKAGE_luci-app-opkg=y
CONFIG_PACKAGE_luci-compat=y
CONFIG_PACKAGE_luci-lib-base=y
CONFIG_PACKAGE_luci-lib-ipkg=y
CONFIG_PACKAGE_parted=y
CONFIG_PACKAGE_chat=y
CONFIG_PACKAGE_comgt=y
CONFIG_PACKAGE_kmod-iwlwifi=y
CONFIG_PACKAGE_kmod-mii=y
CONFIG_PACKAGE_iwlwifi-firmware-ax200=y
CONFIG_PACKAGE_kmod-usb-serial=y
CONFIG_PACKAGE_kmod-usb-acm=y
CONFIG_PACKAGE_kmod-usb-net-cdc-ncm=y
CONFIG_PACKAGE_usbutils=y
CONFIG_PACKAGE_stunnel=y
CONFIG_PACKAGE_zoneinfo-core=y
CONFIG_PACKAGE_zoneinfo-asia=y
CONFIG_PACKAGE_nano=y
CONFIG_PACKAGE_grep=y
CONFIG_PACKAGE_getopt=y
CONFIG_PACKAGE_ip=y
CONFIG_PACKAGE_openssl=y
CONFIG_PACKAGE_nkf=y
CONFIG_PACKAGE_pciutils=y
CONFIG_PACKAGE_kmod-mac80211=y
CONFIG_PACKAGE_wpa-supplicant=y
CONFIG_PACKAGE_hostapd=y
CONFIG_PACKAGE_usb-modeswitch=y
CONFIG_PACKAGE_kmod-cfg80211=y
CONFIG_PACKAGE_tune2fs=y
CONFIG_PACKAGE_resize2fs=y
CONFIG_PACKAGE_coreutils-timeout=y
CONFIG_PACKAGE_kmod-usb-storage=y
CONFIG_PACKAGE_kmod-usb-net-huawei-cdc-ncm=y
CONFIG_PACKAGE_kmod-usb-net-cdc-ether=y
CONFIG_PACKAGE_kmod-usb-net-qmi-wwan=y
CONFIG_PACKAGE_kmod-usb-net-rndis=y
CONFIG_PACKAGE_kmod-usb-serial-qualcomm=y
CONFIG_PACKAGE_kmod-usb-ohci=y
CONFIG_PACKAGE_kmod-nls-utf8=y
CONFIG_PACKAGE_kmod-usb-serial-option=y
CONFIG_PACKAGE_kmod-usb-uhci=y
CONFIG_PACKAGE_kmod-usb2=y
CONFIG_PACKAGE_kmod-usb3=y
CONFIG_PACKAGE_wireless-tools=y
CONFIG_PACKAGE_kmod-rt2800-usb=y
CONFIG_PACKAGE_lsblk=y
CONFIG_PACKAGE_openssh-sftp-server=y
CONFIG_PACKAGE_iperf3=y
CONFIG_PACKAGE_irqbalance=y
CONFIG_PACKAGE_htop=y
CONFIG_PACKAGE_coreutils-base64=y
CONFIG_PACKAGE_coreutils-nohup=y
CONFIG_PACKAGE_kmod=y
CONFIG_PACKAGE_blkid=y
CONFIG_PACKAGE_kmod-mmc=y
CONFIG_PACKAGE_curl=y
CONFIG_PACKAGE_bash=y
CONFIG_PACKAGE_ca-certificates=y
CONFIG_PACKAGE_collectd=y
CONFIG_PACKAGE_lm-sensors=y
CONFIG_PACKAGE_vsftpd=y
CONFIG_PACKAGE_relayd=y
CONFIG_PACKAGE_luci-proto-modemmanager=y
CONFIG_PACKAGE_luci-proto-relay=y
CONFIG_PACKAGE_bc=y
CONFIG_PACKAGE_kmod-usb-net-sierrawireless=y
CONFIG_PACKAGE_kmod-usb-serial-sierrawireless=y
CONFIG_PACKAGE_modeminfo-serial-xmm=y
CONFIG_PACKAGE_ath10k-firmware-qca9888=y
CONFIG_PACKAGE_ath10k-firmware-qca988x=y
CONFIG_PACKAGE_ath10k-firmware-qca9984=y
CONFIG_PACKAGE_autocore=y
CONFIG_PACKAGE_automount=y
CONFIG_PACKAGE_brcmfmac-firmware-43602a1-pcie=y
CONFIG_PACKAGE_default-settings=y
CONFIG_PACKAGE_kmod-ath10k=y
CONFIG_PACKAGE_kmod-mmc-spi=y
CONFIG_PACKAGE_kmod-mt7663u=y
CONFIG_PACKAGE_kmod-mt76x0u=y
CONFIG_PACKAGE_kmod-mt76x2u=y
CONFIG_PACKAGE_kmod-r8125=y
CONFIG_PACKAGE_kmod-rtl8192cu=y
CONFIG_PACKAGE_kmod-rtl8812au-ct=y
CONFIG_PACKAGE_kmod-usb-net-rtl8152-vendor=y
CONFIG_PACKAGE_lm-sensors-detect=y
# CONFIG_PACKAGE_luci-app-accesscontrol is not set
# CONFIG_PACKAGE_luci-app-arpbind is not set
# CONFIG_PACKAGE_luci-app-autoreboot is not set
CONFIG_PACKAGE_luci-app-filetransfer=y
# CONFIG_PACKAGE_luci-app-ksmbd is not set
CONFIG_PACKAGE_luci-app-homeproxy=y
CONFIG_PACKAGE_luci-app-ramfree=y
# CONFIG_PACKAGE_luci-app-serverchan is not set
# CONFIG_PACKAGE_luci-app-upnp is not set
# CONFIG_PACKAGE_luci-app-usb-printer is not set
# CONFIG_PACKAGE_luci-app-vlmcsd is not set
CONFIG_PACKAGE_luci-app-zerotier=y
CONFIG_PACKAGE_luci-ssl=y
CONFIG_PACKAGE_jq=y
CONFIG_PACKAGE_luci-theme-bootstrap=y
# CONFIG_PACKAGE_open-vm-tools is not set
CONFIG_PACKAGE_wpad-basic-mbedtls=y
CONFIG_PACKAGE_luci-proto-xmm=y
CONFIG_PACKAGE_luci-app-modeminfo=y
CONFIG_PACKAGE_luci-app-atinout=y
CONFIG_PACKAGE_modeminfo=y
CONFIG_PACKAGE_pv=y
CONFIG_PACKAGE_ntfs-3g=y
CONFIG_PACKAGE_gzip=y
CONFIG_PACKAGE_rqmi=y
CONFIG_PACKAGE_rmbim=y
CONFIG_PACKAGE_luci-proto-3x=y
CONFIG_PACKAGE_luci-app-passwall=y
CONFIG_PACKAGE_iptables-nft=y
CONFIG_PACKAGE_iptables=y
CONFIG_PACKAGE_kmod-usb-net-cdc-mbim=y
CONFIG_PACKAGE_luci-proto-mbim=y
CONFIG_PACKAGE_luci-proto-qmi=y
CONFIG_PACKAGE_xtables-nft=y
CONFIG_PACKAGE_libxtables12=y
CONFIG_PACKAGE_kmod-ipt-conntrack-extra=y
CONFIG_PACKAGE_iptables-mod-conntrack-extra=y
CONFIG_PACKAGE_iptables-mod-ipopt=y
CONFIG_PACKAGE_kmod-ipt-ipopt=y
CONFIG_PACKAGE_kmod-wwan=y
CONFIG_PACKAGE_wwan=y
CONFIG_PACKAGE_kmod-fs-ext4=y
```
